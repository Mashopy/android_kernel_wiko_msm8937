## drivers/input/fingerprint/Kconfig
```kconfig
#
# fingerprint driver configuration
#

config INPUT_FINGERPRINT
  bool INPUT_FINGERPRINT
  default n
  help
    Switch for tinno fingerprint

config FINGERPRINT_ELAN_96SA_QSEE
  bool FINGERPRINT_ELAN_96SA_QSEE
  default n
  help
    elan Fingerprint chip 96sa/80sa for QSEE
```
